/***********************************
Source code for Wirbelv6, 2010-13
www.brianwevans.com
CC-BY-SA 2013
***********************************/

const byte wind[1464] = {5,5,0,0,0,0,5,5,6,8,14,23,31,35,
39,40,38,34,26,19,13,10,7,5,5,5,0,0,0,0,5,5,6,7,14,23,31,
34,38,40,38,33,26,19,12,10,7,5,5,5,0,0,0,0,5,5,6,8,13,23,
31,35,38,40,38,33,26,18,12,10,7,5,5,5,0,0,0,0,5,5,6,8,13,
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12,16,24,28,29,28,22,18,14,9,8,8,9};

// each fan connected to PWM channel
const byte fan1 = 3;  
const byte fan2 = 5;
const byte fan3 = 6;
const byte fan4 = 9;
const byte fan5 = 10;
const byte fan6 = 11;

// status LED on pin13
const byte stat = 13;

byte oldVal1 = 0;
byte oldVal2 = 0;
byte oldVal3 = 0;
byte oldVal4 = 0;
byte oldVal5 = 0;
byte oldVal6 = 0;

byte a = 0;
byte b = 1;
byte c = 2;
byte d = 3;
byte e = 4;
byte f = 5;

float stepVal;

void setup() {
  pinMode(stat, OUTPUT);

  // LED flashes to warn that the fans are starting up
  for(int i=0; i<=4; i++){
    digitalWrite(stat, HIGH);
    delay(500);
    digitalWrite(stat, LOW);
    delay(500);
  }
}

void loop() {
    for(int j=0; j<10; j++){
      
      // FAN 1
      if(wind[a] > oldVal1){
        stepVal = (wind[a] - oldVal1) / 10;
        analogWrite(fan1, (int((j+1)*stepVal))+oldVal1);
      }else{                         
        stepVal = (oldVal1 - wind[a]) / 10;   
        analogWrite(fan1, oldVal1-(int((j+1)*stepVal)));
      }
      
      // FAN 2
      if(wind[b] > oldVal2){
        stepVal = (wind[b] - oldVal2) / 10;
        analogWrite(fan2, (int((j+1)*stepVal))+oldVal2);
      }else{                         
        stepVal = (oldVal2 - wind[b]) / 10;   
        analogWrite(fan2, oldVal2-(int((j+1)*stepVal)));
      }
      
      // FAN 3
      if(wind[c] > oldVal3){
        stepVal = (wind[c] - oldVal3) / 10;
        analogWrite(fan3, (int((j+1)*stepVal))+oldVal3);
      }else{                         
        stepVal = (oldVal3 - wind[c]) / 10;   
        analogWrite(fan3, oldVal3-(int((j+1)*stepVal)));
      }
      
      // FAN 4
      if(wind[d] > oldVal4){
        stepVal = (wind[d] - oldVal4) / 10;
        analogWrite(fan4, (int((j+1)*stepVal))+oldVal4);
      }else{                         
        stepVal = (oldVal4 - wind[d]) / 10;   
        analogWrite(fan4, oldVal4-(int((j+1)*stepVal)));
      }
      
      // FAN 5
      if(wind[e] > oldVal5){
        stepVal = (wind[e] - oldVal5) / 10;
        analogWrite(fan5, (int((j+1)*stepVal))+oldVal5);
      }else{                         
        stepVal = (oldVal5 - wind[e]) / 10;   
        analogWrite(fan5, oldVal5-(int((j+1)*stepVal)));
      }
      
      // FAN 6
      if(wind[f] > oldVal6){
        stepVal = (wind[f] - oldVal6) / 10;
        analogWrite(fan6, (int((j+1)*stepVal))+oldVal6);
      }else{                         
        stepVal = (oldVal6 - wind[f]) / 10;   
        analogWrite(fan6, oldVal6-(int((j+1)*stepVal)));
      }
      
      delay(100);
      digitalWrite(stat, HIGH);  
    }
    
    oldVal1 = wind[a];               
    oldVal2 = wind[b];
    oldVal3 = wind[c];
    oldVal4 = wind[d];
    oldVal5 = wind[e];
    oldVal6 = wind[f];
    
    a++;
    b++;
    c++;
    d++;
    e++;
    f++;
    
    if(a > 1464) a = 0;
    if(b > 1464) b = 0;
    if(c > 1464) c = 0;
    if(d > 1464) d = 0;
    if(e > 1464) e = 0;
    if(f > 1464) f = 0;
    
    digitalWrite(stat, LOW);
}

